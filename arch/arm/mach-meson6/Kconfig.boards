## arch/arm/mach-meson6/Kconfig.boards
```kconfig
if ARCH_MESON6

config MACH_MESON6_SKT
	depends on ARCH_MESON6
	bool "Meson6 socket board"
	default y 
	help
          Support for Amlogic Meson6 socket board.

config MACH_MESON6_REF
	depends on ARCH_MESON6
	bool "Meson6 reference board"
	default y 
	help
          Support for Amlogic Meson6 reference development platform.
          
config MACH_MESON6_REFG18_ATV103
	depends on ARCH_MESON6
	bool "Visson ATV-103 board"
	default y 
	help
          Support for Visson ATV-103 MX device

endif # ARCH_MESON6
```

## arch/arm/mach-meson6tv/Kconfig.boards
```kconfig
if ARCH_MESON6TV

config BOARD_MESON6TV_SKT
	depends on ARCH_MESON6TV
	bool "Meson6TV socket board"
	default y
	help
          Support for Amlogic Meson6TV socket board.

config BOARD_MESON6TV_REF
	depends on ARCH_MESON6TV
	bool "Meson6TV reference board"
	default y
	help
          Support for Amlogic Meson6TV reference development platform.

endif # ARCH_MESON6TV
```

## drivers/amlogic/Kconfig
```kconfig
#
# Amlogic driver configuration
#
menu "Amlogic Device Drivers"
	depends on PLAT_MESON

config AM_NEW_TV_ARCH
	bool "Amlogic new TV frontend drviers architecture"
	default n
	help
		Use new TV frontend drivers architecture.

#
#	Char devices
#
comment "Char devices"
source "drivers/amlogic/regd/Kconfig"
source "drivers/amlogic/uart/Kconfig"
source "drivers/amlogic/rtc/Kconfig"
source "drivers/amlogic/i2c/Kconfig"
source "drivers/amlogic/input/Kconfig"
source "drivers/amlogic/power/Kconfig"
#source "drivers/amlogic/extern_io/Kconfig"
source "drivers/amlogic/gpio/Kconfig"
#source "drivers/amlogic/minilvds/Kconfig"
source "drivers/amlogic/efuse/Kconfig"
source "drivers/amlogic/smartcard/Kconfig"
source "drivers/amlogic/gps/Kconfig"
#source "drivers/amlogic/modem/Kconfig"
source "drivers/amlogic/debug/Kconfig"
source "drivers/amlogic/sensors/Kconfig"
source "drivers/amlogic/boot_monitor/Kconfig"
source "drivers/amlogic/watchdog/Kconfig"

#
#	Block devices
#
comment "Block devices"
source "drivers/amlogic/usb/Kconfig"
#source "drivers/amlogic/sata/Kconfig"
source "drivers/amlogic/cardreader/Kconfig"
source "drivers/amlogic/mmc/Kconfig"
source "drivers/amlogic/spi_nor/Kconfig"
source "drivers/amlogic/nand/Kconfig"

if !AM_NEW_TV_ARCH
source "drivers/amlogic/demod/Kconfig"
endif

#
#	Network devices
#
comment "Network devices"
source "drivers/amlogic/ethernet/Kconfig"
source "drivers/amlogic/wifi/Kconfig"
source "drivers/amlogic/bluetooth/Kconfig"

#
#	Media devices
#
comment "Media devices"
config AML_VSYNC_FIQ_ENABLE
	bool "Enable Amlogic VSYNC FIQ"
	default n
	help
		enable vsync FIQ.

#
#  Audio
#
source "drivers/amlogic/amports/Kconfig"
source "drivers/amlogic/amaudio/Kconfig"
source "drivers/amlogic/audiodsp/Kconfig"
#
#  Video
#
source "drivers/amlogic/canvas/Kconfig"
source "drivers/amlogic/display/Kconfig"
source "drivers/amlogic/hdmi/Kconfig"
#source "drivers/amlogic/tvin/Kconfig"
source "drivers/amlogic/tvin_camera/Kconfig"
#source "drivers/amlogic/cmem/Kconfig"
#source "drivers/amlogic/jpeglogo/Kconfig"
#source "drivers/amlogic/dvb/Kconfig"
source "drivers/amlogic/ppmgr/Kconfig"
source "drivers/amlogic/camera/Kconfig"
source "drivers/amlogic/video_dev/Kconfig"
source "drivers/amlogic/deinterlace/Kconfig"
source "drivers/amlogic/freescale/Kconfig"
source "drivers/amlogic/mipi/Kconfig"
source "drivers/amlogic/d2d3/Kconfig"
source "drivers/amlogic/amvecm/Kconfig"
source "drivers/amlogic/mhl/Kconfig"

if !AM_NEW_TV_ARCH
source "drivers/amlogic/dvb/Kconfig"
endif

if AM_NEW_TV_ARCH
source "drivers/amlogic/dvb_tv/Kconfig"
endif

#3G module power manager
source "drivers/amlogic/modem/Kconfig"

#deferred module for speed
source "drivers/amlogic/load_deferred_module/Kconfig"

#
#	ARM Mali
#
comment "ARM Mali"
isource "drivers/amlogic/ump/Kconfig"
isource "drivers/amlogic/mali/Kconfig"
comment "ARM Mali (external)"
isource "../hardware/arm/gpu/ump/Kconfig"
isource "../hardware/arm/gpu/mali/Kconfig"
source "drivers/amlogic/spi/Kconfig"

#
# crypto
#
source "drivers/amlogic/crypto/Kconfig"

endmenu
```

## drivers/amlogic/bluetooth/mtk_wcn_bt/Kconfig
```kconfig
menu "MediaTek Bluetooth Chip Config"

config MTK_DISCRETE_BT
	bool "MediaTek Discrete Bluetooth Chip Support"
	help
	  MTK discrete Bluetooth chip support (MT6622, MT6626)

config MTK_DISCRETE_BT_HW_CTL
	bool "MediaTek Bluetooth Hardware Control driver"
	depends on MTK_DISCRETE_BT
	help
	  MTK BT hardware control driver for discrete Bluetooth chip

endmenu
```

## drivers/amlogic/demod/Kconfig
```kconfig
menu "AMLOGIC DEMOD Support"

menuconfig AM_DEMOD
	tristate "Amlogic demod driver"
	default n
	depends on AM_DVB
	help
		m1 internal Demod DVB-T/C suport

if AM_DEMOD

config AM_DEMOD_DVBAPI
       bool "Amlogic Demod DVBAPI Interface"
	default y
       depends on AM_DEMOD
       help
               m1 internal Demod DVBAPI Interface

config AM_DEMOD_DEBUG
	bool "Amlogic Demod Debug Interface"
	default n
	depends on AM_DEMOD
	help
		m1 internal Demod debug interface

config AM_AMDEMOD_DVBC
	bool "AML DVBC demod driver"
	default y
	depends on AM_DEMOD
	help
		m1 internal Demod DVB-C Driver

config AM_AMDEMOD_DVBT
	bool "AML DVBT demod driver"
	default y
	depends on AM_DEMOD
	help
		m1 internal Demod DVB-T Driver

config AM_AMDEMOD_ISDBT
	bool "AML ISDBT demod driver"
	default y
	depends on AM_DEMOD
	help
		m1 internal Demod ISDB-T Driver
		
config AM_AMDEMOD_DTMB
	bool "AML DTMB demod driver"
	default y
	depends on AM_DEMOD
	help
		m1 internal Demod DTMB Driver
		
config AM_AMDEMOD_ATSC
	bool "AML ATSC demod driver"
	default y
	depends on AM_DEMOD
	help
		m1 internal Demod ATSC Driver
		

config AM_AMDEMOD_FPGA_VER
	bool "AML Demod FPGA VERSION"
	default y
	depends on AM_DEMOD 
#	depends on !SDIO
	help
		m1 Demod FPGA Version

endif	# AM_DEMOD
		
endmenu
```

## drivers/amlogic/dvb/Kconfig
```kconfig
#
# Smart card driver configuration
#

menu "AMLOGIC DVB driver"

config AM_DVB
	tristate "AMLOGIC DVB driver"
	default n
	select DVB_CORE
	help
		Select to enable AMLogic DVB driver.

menu "AMLOGIC CI Driver"

config AM_CI
	tristate "Amlogic Common Interface driver"
	default n
	depends on AM_DVB
	select AM_PCMCIA
	select AM_IOBUS
	help
		Select to enable Amlogic CI driver.

config AM_PCMCIA
	tristate "Amlogic PCMCIA driver"
	default n
	help
		Select to enable Amlogic PCMCIA driver.
	
config AM_IOBUS
	tristate "Amlogic IOBUS driver"
	default n
	help
		Select to enable Amlogic IOBUS driver.

endmenu

config AMLOGIC_S_TS0
	bool "Serial TS0"
	default n
	depends on AM_DVB
	help
		TS0 in serial mode.

config AMLOGIC_S_TS1
	bool "Serial TS1"
	default n
	depends on AM_DVB
	help
		TS1 in serial mode.

config AMLOGIC_S_TS2
	bool "Serial TS2"
	default n
	depends on AM_DVB
	help
		TS0 in serial mode.

config AM_GX1001
	tristate "GX1001 demod driver"
	default n
	depends on AM_DVB
	help
		Select to enable GX1001 demod driver.
		
config AM_MXL101
	tristate "MXL101 demod driver"
	default n
	depends on AM_DVB
	help
		Select to enable MXL101 demod driver.

source "drivers/amlogic/dvb/avl6211/Kconfig"

config AM_ITE9173
	tristate "ITE9173 demod driver"
	default n
	depends on AM_DVB
	help
		Select to enable ITE9173 demod driver.	

config AM_ITE9133
	tristate "ITE9133 demod driver"
	default n
	depends on AM_DVB
	help
		Select to enable ITE9133 demod driver.	

source "drivers/amlogic/dvb/dib7090/Kconfig"

config AM_LGS9XB1
	tristate "LGS9XB1 demod driver"
	default n
	depends on AM_DVB
	help
		Select to enable LGS9XB1 demod driver.	

endmenu
```

## drivers/amlogic/dvb_tv/Kconfig
```kconfig
#
# Smart card driver configuration
#

menu "AMLOGIC DVB driver"

config AM_DVB
	tristate "AMLOGIC DVB driver"
	default n
	select DVB_CORE
	help
		Select to enable AMLogic DVB driver.

menu "AMLOGIC CI Driver"

config AM_CI
	tristate "Amlogic Common Interface driver"
	default n
	depends on AM_DVB
	select AM_PCMCIA
	select AM_IOBUS
	help
		Select to enable Amlogic CI driver.

config AM_PCMCIA
	tristate "Amlogic PCMCIA driver"
	default n
	help
		Select to enable Amlogic PCMCIA driver.
	
config AM_IOBUS
	tristate "Amlogic IOBUS driver"
	default n
	help
		Select to enable Amlogic IOBUS driver.

endmenu

config AMLOGIC_TS0
	bool "Enable TS0"
	default n
	depends on AM_DVB
	help
		Enable TS0.

config AMLOGIC_TS1
	bool "Enable TS1"
	default n
	depends on AM_DVB
	help
		Enable TS1.

config AMLOGIC_TS2
	bool "Enable TS2"
	default n
	depends on AM_DVB
	help
		Enable TS2.

config AMLOGIC_S_TS0
	bool "Serial TS0"
	default n
	depends on AM_DVB
	help
		TS0 in serial mode.

config AMLOGIC_S_TS1
	bool "Serial TS1"
	default n
	depends on AM_DVB
	help
		TS1 in serial mode.

config AMLOGIC_S_TS2
	bool "Serial TS2"
	default n
	depends on AM_DVB
	help
		TS0 in serial mode.

config AM_MXL101
	tristate "MXL101 demod driver"
	default n
	depends on AM_DVB
	help
		Select to enable MXL101 demod driver.

config AM_AVL6211
	tristate "AVL6211 demod driver"
	default n
	depends on AM_DVB
	help
		Select to enable AVL6211 demod driver.	
		
config AM_M6_DEMOD
	tristate "M6 demod driver"
	default y
	depends on AM_DVB
	help
		Select to enable M6 demod driver.

config AM_SI2176
    tristate "SI2176 tuner driver"
    default n
    depends on AM_DVB
	help
		Select to enable SI2176 driver.
config AM_SI2196
    tristate "SI2196 tuner driver"
    default n
    depends on AM_DVB
	help
		Select to enable SI2196 driver.
config AM_CTC703
	tristate "CRESTA tuner driver"
	default n
	depends on AM_DVB
	help
		select the cresta tuner.		
		
endmenu
```

## drivers/amlogic/hdmi/Kconfig
```kconfig
menu "Amlogic HDMI TX Support"


config AML_HDMI_TX
        bool "HDMI Output Enable"
        default y
        select SWITCH
        select AM_DISPLAY_MODULE
        help  
                hdmi output enable,It should be enalbe if board have hdmi out interface
endmenu
```

## drivers/amlogic/load_deferred_module/Kconfig
```kconfig
menu  "Amlogic deferred module support"
    depends on DEFERRED_MODULE_INIT
config DEFERRED_DRIVERINIT
        tristate "Amlogic deferred Driver init call"
	default m
	help
          deferred driver init call for saving time of bootup kernel

endmenu
```

## drivers/amlogic/mhl/Kconfig
```kconfig
#
# MHL devices configuration
#

menuconfig AML_MHL
	tristate "Amlogic MHL Support"
	default n

if AML_MHL

source "drivers/amlogic/mhl/sii1292/Kconfig"
source "drivers/amlogic/mhl/ep94m3/Kconfig"

endif
```

## drivers/amlogic/mhl/ep94m3/Kconfig
```kconfig
#
# EP94M3 devices configuration
#

config MHL_EP94M3
	tristate "EP94M3 MHL/HDMI Support"
	default n
	help
	  EP94M3 is a 3-Port MHL/HDMI Dual Mode Switcher.
	  The chip supports 3 MHL/HDMI input ports working in dual mode
	  and 1 HDMI output port.
```

## drivers/amlogic/mhl/sii1292/Kconfig
```kconfig
#
# SiI1292 devices configuration
#

config MHL_SII1292
	tristate "SiI1292 MHL/HDMI-to-HDMI Bridge Support"
	default n
	help
	  SiI1292 MHL/HDMI-to-HDMI Bridge Device Driver

choice
	prompt "SiI1292 CI2CA Pin"
	depends on MHL_SII1292
	default MHL_SII1292_CI2CA_PULLDOWN
	help
	  "SiI1292 CI2CA Pin Pull Down/Up"

config MHL_SII1292_CI2CA_PULLDOWN
	bool "Pull Down"

config MHL_SII1292_CI2CA_PULLUP
	bool "Pull Up"

endchoice

config MHL_SII1292_CEC
	bool "Support CEC"
	depends on MHL_SII1292
	default n
```

## drivers/amlogic/modem/Kconfig
```kconfig
menu "Amlogic intenal modem  Support"

config AMLOGIC_MODEM
	bool "Amlogic intenal modem  support"
	select IN_3G_SUPPLY
	default n
	help
	  Say Y here if you want to use the amlogic intenal modem management.

config AMLOGIC_MODEM_PM
	bool "Amlogic intenal modem power on/off when system suspend/resume"
	depends on AMLOGIC_MODEM
	---help---
	  Say Y here if you want to control intenal modem power
	  when system suspends/resumes.

	  If unsure, say N.

choice
    depends on AMLOGIC_MODEM_PM
    prompt "intenal modem power management type"

config AMLOGIC_MODEM_PM_OFF_MODE
    bool "modem off when system suspend"
    
config AMLOGIC_MODEM_PM_SLEEP_MODE
    bool "modem suspend when system suspend"

endchoice	  

config USE_EARLYSUSPEND
	depends on AMLOGIC_MODEM_PM && HAS_EARLYSUSPEND
	bool "use earlysuspend"
	---help---
	  Say Y here if you want to use earlysuspend to control intenal modem power,
	  N means using normal suspend.

endmenu
```

## drivers/amlogic/power/Kconfig
```kconfig
menu "Amlogic Power Management Support"

config AMLOGIC_PM
	bool "Amlogic Power support"
	select POWER_SUPPLY
	default n
	help
	  Say Y here if you want to use the Amlogic power management.
	  
config CW2015
	bool "CellWise gasgauge"
	select POWER_SUPPLY
	select I2C
	default n
	help
	  Say Y here if you want to use the CellWise gasgauge.

config SMBA10XX_BATTERY
	boolean "SMBA10XX battery driver support"
	select I2C
	default n
	help
	  Say Y if you want to add battery driver supoort for SMBA10XX
	  
config BQ27x00_BATTERY
	bool "BQ27x00 Battery support"
	select POWER_SUPPLY
	select I2C
	default n
	help
	  Say Y here if you want to add battery driver supoort for bq27x00.

config UBOOT_BATTERY_PARAMETERS
	bool "battery parameters get from uboot support"
	select POWRE_SUPPLY
	default n
	help
	    Say y if you want to get battery parameters from uboot

source "drivers/amlogic/power/act8xxx_pmu/Kconfig"
source "drivers/amlogic/power/axp_power/Kconfig"
source "drivers/amlogic/power/meson_cs_dcdc_regulator/Kconfig"
source "drivers/amlogic/power/aml_pmu/Kconfig"
endmenu
```

## drivers/amlogic/power/aml_pmu/Kconfig
```kconfig
menuconfig AML_PMU
    bool    "Amlogic PMU drivers"
    select  I2C
    select  REGULATOR
    default n
    ---help---
        say yes if you want add Amlogic power management unit support
if AML_PMU
choice 
    prompt "AML PMU type"
    default AML1212
config AML1212
    bool "AML1212 driver"
    ---help---
        drivers for AML1212

endchoice

endif #AML_PMU
```

## drivers/amlogic/sensors/Kconfig
```kconfig
menuconfig AM_SENSORS
	bool "Amlogic Sensors support"
	default n

if AM_SENSORS

config MPU3050
	bool "InvenSense MPU-3050 6-axis sensor"
	depends on MISC_DEVICES
	default n
	help
	 Invensense mpu3050 sensors
	#source "drivers/amlogic/sensors/mpu3050/Kconfig"

config MPU3050_v4_1_2
	bool "version 4.1.2 InvenSense MPU 6-axis sensor"
	depends on MISC_DEVICES
	default n
	help
	 Invensense mpu3050 sensors driver version 4.1.2
	source "drivers/amlogic/sensors/inv_mpu/Kconfig"

config LIGHT_SENSOR
	bool "LightSensor"
	depends on INPUT
	default n
	help
	 GL3526 Light Sensor
	 	 
endif # AM_SENSORS
```

## drivers/amlogic/sensors/aml_Gsensor/Kconfig
```kconfig
if AMLOGIC_Gsnesor
menu "Amlogic GSensor Support"

config AML_SENSORS_MMA845X
    bool "Freescale mma8451/8452/8453"
    depends on AMLOGIC_Gsnesor
    help
    	Say Y here if you want to use the amlogic Gsensor drivers for mma845x.
	  
endmenu
endif #AMLOGIC_Gsnesor
```

## drivers/amlogic/smartcard/Kconfig
```kconfig
#
# Smart card driver configuration
#

menu "Amlogic Smartcard Driver"

config AM_SMARTCARD
	tristate "Amlogic Smartcard driver"
	default n
	help
		Select to enable Smartcard driver.
endmenu
```

## drivers/amlogic/tvin/it660x/Kconfig
```kconfig
#
#Hdmirx It660xin Device Driver Configuration
#
config TVIN_IT660X
    tristate "Amlogic IT660XIN device driver" 
    default  n
    help
         Amlogic IT660XIN device driver.
```

## drivers/amlogic/tvin/tvafe/Kconfig
```kconfig
#
# TVAFE Device Driver Configuration
#


config TVIN_AFE
	tristate "Amlogic AFE device driver"
	default n
	help
	  AFE device driver.
```
