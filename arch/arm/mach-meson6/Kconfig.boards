## drivers/amlogic/tvin_camera/Kconfig
```kconfig
#
# Amlogic tvin devices configuration
#

menu "Amlogic TVIN Support"

config TVIN_MPEG
	bool "Amlogic TVIN MPEGIN device"
	default n
	help
		MPEG device driver.

config TVIN_HDMI
	bool "Amlogic TVIN HDMIRX device"
	default n
	help
		HDMI device driver.

config TVIN_BT656IN
	bool "Amlogic TVIN BT656IN device"
	default n
	help
		BT656IN device driver.

config TVIN_DVIN
	bool "Amlogic TVIN DVIN device"
	default n
	help
		DVIN device driver.

config TVIN_AFE
	bool "Amlogic TVIN TVAFE device"
	default n
	depends on ARCH_MESON2
	help
		AFE device driver.

config TVIN_VIUIN
	bool "Amlogic TVIN VIUIN device"
	default n
	help
		VIUIN device driver.

config TVIN_IT660X
	bool "Amlogic TVIN IT660X HDMIRX device"
	default n
	help
		HDMI device driver.

config TVIN_VDIN
	bool "Amlogic TVIN VDIN device"
	default n
	help
		VDIN devices driver.

config TVIN_VDIN_MINI_CONFIG
	bool "Amlogic TVIN VDIN MINIMUM MEM CONFIG"
	default n
	help
		if vdin's mem_size no more than  16M, enable it

config GAMMA_PROC
	bool "Amlogic GAMMA auto tunning module"
	default n
	help
		GAMMA auto tunning module.

source "drivers/amlogic/tvin_camera/tuners/Kconfig"

endmenu
```

## drivers/amlogic/watchdog/Kconfig
```kconfig
#
# watchdog configuration
#

menuconfig AML_WDT
	tristate "Amlogic Watchdog Support"
	default n

if AML_WDT

source "drivers/amlogic/watchdog/wdt/Kconfig"
source "drivers/amlogic/watchdog/wdt_tv/Kconfig"

endif
```

## drivers/amlogic/watchdog/wdt/Kconfig
```kconfig
config AML_WATCHDOG
	bool "Amlogic Watchdog"
	default n
	---help---
	  This module works as watch dog for platform.
```

## drivers/amlogic/watchdog/wdt_tv/Kconfig
```kconfig
#
# AMLOGIC TV Watchdog
#

config AML_WATCHDOG_TV
	bool "Amlogic TV Watchdog"
	default n
	help
	  Amlogic tv watchdog timer embedded in chip.
```

## drivers/amlogic/wifi/broadcm_40181/Kconfig
```kconfig
config SDIO_DHD_CDC_WIFI_40181_MODULE
	tristate "Broadcom 4329/4330 wireless cards support"
	depends on AM_WIFI_SD_MMC || SD_MMC
	---help---
	  This module adds support for wireless adapters based on
	  Broadcom 4329/4330 chipset.

choice
    depends on SDIO && SDIO_DHD_CDC_WIFI_40181_MODULE
    prompt "Wi-Fi module type"

config BCM40181_WIFI
    bool "40181 without bluetooth"
config BCM40183_WIFI
    bool "40183 with bluetooth"

endchoice

choice
    depends on SDIO && SDIO_DHD_CDC_WIFI_40181_MODULE
    prompt "Interrupt type"
config BCMDHD_OOB
	depends on SDIO_DHD_CDC_WIFI_40181_MODULE
	bool "Out-of-Band Interrupt"
	---help---
	  Out-of-Band interrupt through WL_HOST_WAKE.

config SDIO_HARD_IRQ
	depends on SDIO && SDIO_DHD_CDC_WIFI_40181_MODULE
	bool "In-Band Interrupt"
	default y
	---help---
		In-Band interrupt through SDIO DAT[1]
endchoice

config BCMDHD_FW_PATH
	depends on SDIO && SDIO_DHD_CDC_WIFI_40181_MODULE
	string "Firmware path"
	default "/system/etc/wifi/40183/fw_bcmdhd.bin"
	---help---
	  Path to the firmware file.

config BCMDHD_NVRAM_PATH
	depends on SDIO && SDIO_DHD_CDC_WIFI_40181_MODULE
	string "NVRAM path"
	default "/system/etc/wifi/40183/nvram.txt"
	---help---
	  Path to the calibration file.

config BCMDHD_WEXT
	bool "Enable WEXT support"
	depends on SDIO_DHD_CDC_WIFI_40181_MODULE && CFG80211 = n
	select WIRELESS_EXT
	select WEXT_PRIV
	help
	  Enables WEXT support

config DHD_USE_SCHED_SCAN
	bool "Use CFG80211 sched scan"
	depends on SDIO_DHD_CDC_WIFI_40181_MODULE && CFG80211
	default n
	---help---
	  Use CFG80211 sched scan

choice
    depends on BCMDHD
    prompt "Interrupt type"
config BCMDHD_OOB
	depends on BCMDHD
	bool "Out-of-Band Interrupt"
	---help---
		Interrupt through WL_HOST_WAKE.
config SDIO_HARD_IRQ
	depends on  BCMDHD
	bool "In-Band Interrupt"
	default y
	---help---
		Interrupt through SDIO DAT[1]
endchoice
```
