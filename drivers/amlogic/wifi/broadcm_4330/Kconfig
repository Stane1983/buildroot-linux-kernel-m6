## drivers/amlogic/wifi/broadcm_4330/Kconfig
```kconfig
config SDIO_DHD_CDC_WIFI_4330_MODULE
	tristate "Broadcom 4329/30 wireless cards support"
	depends on AM_WIFI_SD_MMC || MMC
	---help---
	  This module adds support for wireless adapters based on
	  Broadcom 4329/30 chipset.

	  This driver uses the kernel's wireless extensions subsystem.

	  If you choose to build a module, it'll be called dhd. Say M if
	  unsure.

config BCMDHD_FW_PATH
	depends on SDIO_DHD_CDC_WIFI_4330_MODULE
	string "Firmware path"
	default "/system/etc/firmware/fw_bcmdhd.bin"
	---help---
	  Path to the firmware file.

config BCMDHD_NVRAM_PATH
	depends on SDIO_DHD_CDC_WIFI_4330_MODULE
	string "NVRAM path"
	default "/system/etc/firmware/bcmdhd.cal"
	---help---
	  Path to the calibration file.

config BCMDHD_WEXT
	bool "Enable WEXT support"
	depends on SDIO_DHD_CDC_WIFI_4330_MODULE
	select WIRELESS_EXT
	select WEXT_PRIV
	help
	  Enables WEXT support

config DHD_USE_STATIC_BUF
	bool "Enable memory preallocation"
	depends on SDIO_DHD_CDC_WIFI_4330_MODULE
	default n
	---help---
	  Use memory preallocated in platform
```

## sound/soc/aml/Kconfig
```kconfig
config SND_AML_SOC
	tristate "Audio for Amlogic Meson SoC"
	depends on PLAT_MESON
	help
	  Say Y or M if you want to add support for codecs attached to
	  the Amlogic I2S interface. You will also need
	  to select the audio interfaces to support below.

config SND_AML_M1
	tristate "M1 evaluation board with internel audio dac"
	depends on SND_AML_SOC
	depends on ARCH_MESON1

config SND_AML_M1_MID_WM8900
	tristate "AML6236 MID board with WM8900"
	depends on SND_AML_SOC
        select SND_SOC_WM8900 if SND_AML_M1_MID_WM8900

config SND_AML_M1_ARMDEV_WM8900
	tristate "AML8726M ARM Dev board with WM8900"
	depends on SND_AML_SOC
	select SND_SOC_WM8900 if SND_AML_M1_ARMDEV_WM8900

config SND_AML_M1_MID_RT5621
	tristate "AML8726M MID board with RT5621"
	depends on SND_AML_SOC
	select SND_SOC_RT5621 if SND_AML_M1_MID_RT5621

config SND_AML_M2
	tristate "M2 evaluation board with internal audio codec"
	depends on SND_AML_SOC
	depends on ARCH_MESON2

config SND_AML_M3
	tristate "M3 evaluation board with internal audio codec"
	depends on SND_AML_SOC
	depends on ARCH_MESON3

config SND_AML_M6_RT5631
	tristate "M6 evaluation board with RT56331"
	depends on SND_AML_SOC
	select SND_SOC_RT5631 if SND_AML_M6_RT5631

config SND_AML_M6_RT3261
	tristate "M6 evaluation board with RT3261"
	depends on SND_AML_SOC
	select SND_SOC_RT3261 if SND_AML_M6_RT3261
	select SND_HWDEP
config SND_AML_M6_WM8960
	tristate "M6 evaluation board with WM8960"
	depends on SND_AML_SOC
	select SND_SOC_WM8960 if SND_AML_M6_WM8960

config SND_AML_M_DUMMY_CODEC
    tristate "AML M series board with DUMMY_CODEC"
    depends on SND_AML_SOC
    select SND_SOC_DUMMY_CODEC if SND_AML_M_DUMMY_CODEC
config SND_AML_M6TV_AUDIO_CODEC
	tristate "AML M6TV evaluation board,this must be selected for all m6tv board"
	depends on SND_AML_SOC
config SND_AML_M6TV_SYNOPSYS9629_CODEC
	tristate "AML M6TV  board with internal syno9629 codec"
	depends on SND_AML_M6TV_AUDIO_CODEC 
config SND_AML_M6TV_RT5631
	tristate "AML M6TV board with RT5631 codec"
	depends on SND_AML_M6TV_AUDIO_CODEC
	select SND_SOC_RT5631 if SND_AML_M6TV_RT5631	
config SND_AML_M6TV_STA380
	tristate "AML M6TV board with STA380 codec"
	depends on SND_AML_M6TV_AUDIO_CODEC
	select SND_SOC_STA380 if SND_AML_M6TV_STA380	
config SND_AML_M6TV_TAS5711
	tristate "AML M6TV board with TAS5711 codec"	
	depends on SND_AML_M6TV_AUDIO_CODEC	
	select SND_SOC_TAS5711 if SND_AML_M6TV_TAS5711
if SND_AML_M6TV_TAS5711
choice        
	prompt "TAS5711 work mode"        
	default TAS5711_2_CHANNEL
config TAS5711_2_CHANNEL        
	bool "2 BTL channel mode"
config TAS5711_2_PLUS_1_CHANNEL
	bool "2.1 channel mode"
config TAS5711_2_SUBWOOFER_CHANNEL        
	bool "2 BTL subwoofer channel"
endchoice
endif
config SND_AML_M6TV_TAS5707
	tristate "AML M6TV board with TAS5707 codec"	
	depends on SND_AML_M6TV_AUDIO_CODEC	
	select SND_SOC_TAS5707 if SND_AML_M6TV_TAS5707
if SND_AML_M6TV_TAS5707
choice        
	prompt "TAS5707 work mode"        
	default TAS5707_2_CHANNEL
config TAS5707_2_CHANNEL        
	bool "2 BTL channel mode"
config TAS5707_2_SUBWOOFER_CHANNEL        
	bool "2 BTL subwoofer channel"
endchoice
endif
```
